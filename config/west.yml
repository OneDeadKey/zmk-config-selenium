## config/west.yml
```yaml
manifest:
  remotes:
    - name: zmkfirmware
      url-base: https://github.com/zmkfirmware
    - name: keebs34
      url-base: https://github.com/keebs34
    - name: NuclearSquid
      url-base: https://github.com/Nuclear-Squid
    - name: raeedcho
      url-base: https://github.com/raeedcho
    - name: rloutier
      url-base: https://github.com/rloutier
  projects:
    - name: zmk
      remote: zmkfirmware
      revision: main
      import: app/west.yml
    - name: zmk-keyboard-quacken
      remote: NuclearSquid
      revision: main
    - name: zmk-keyboard-totem
      remote: keebs34
      revision: main
    - name: temper-zmk-config
      remote: raeedcho
      revision: main
    - name: zmk-config-go60
      remote: rloutier
      revision: main
  self:
    path: config
```
