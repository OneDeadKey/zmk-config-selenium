#ifndef SLN_BASE_LAYER
#define SLN_BASE_LAYER(name, LOUT1,  LROW1,  RROW1,  ROUT1, \
                             LOUT2,  LROW2,  RROW2,  ROUT2, \
                             LOUT3,  LROW3,  RROW3,  ROUT3, \
                             LT1, LT2, LT3,  RT3, RT2, RT1) \
    SLN_LAYER(name, LROW1   RROW1 \
                    LROW2   RROW2 \
                    LROW3   RROW3 \
                  LT1 LT2   RT2 RT1)
#endif

#include "../include/selenium/selenium.keymap"
